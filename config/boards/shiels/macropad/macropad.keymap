#include <behavious.dsti>
#include <dt-bindings/zmk/keys.h>

/{
    keymap {
        compatible = "zmk,keymap";

        default_layer {
            bindings_layer {
                bindings = <
                    &kp A
                >;
            };
        };
    };
};