#include <behaviors.dtsi>
#include <dt-bindings/zmk/keys.h>

/{
    keymap {
        compatible = "zmk,keymap";

        default_layer {
            bindings = <
                &kp K_VOL_UP
                &kp UP
                &kp K_VOL_DN
                &kp LEFT
                &kp DOWN
                &kp RIGHT
                &kp F
                &kp SPACE
                &kp M
            >;
        };
    };
};