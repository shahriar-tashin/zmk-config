/*
 * Copyright (c) 2020 The ZMK Contributors
 *
 * SPDX-License-Identifier: MIT
 */

#include <behaviors.dtsi>
#include <dt-bindings/zmk/bt.h>
#include <dt-bindings/zmk/keys.h>
#include <dt-bindings/zmk/outputs.h>


/* Enable ONLY ONE of the &encoder_1 nodes. They are wired to the same pins.*/
/*
&encoder_1 {
    status = "okay";
};
&encoder_1_top_left {
    status = "okay";
};
*/

/*
&encoder_2 {
    status = "okay";
};

&encoder_3 {
    status = "okay";
};
*/


/* Add any encoder(s) you have enabled to the sensors node, separated by spaces. */

/ {
    keymap {
        compatible = "zmk,keymap";

        default_layer {
            bindings = <
                                &kp A
            >;
        };
    };
};
